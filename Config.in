## Config.in
```kconfig
menu "Custom packages"
 	source "$BR2_EXTERNAL_MINIMAL_RPI_PATH/package/headunit-desktop/Config.in" 
 	source "$BR2_EXTERNAL_MINIMAL_RPI_PATH/package/libcanberra/Config.in" 
 	source "$BR2_EXTERNAL_MINIMAL_RPI_PATH/package/libqofono/Config.in" 
 	source "$BR2_EXTERNAL_MINIMAL_RPI_PATH/package/bluez-qt/Config.in" 
 	source "$BR2_EXTERNAL_MINIMAL_RPI_PATH/package/extra-cmake-modules/Config.in" 
 	source "$BR2_EXTERNAL_MINIMAL_RPI_PATH/package/gconf2/Config.in" 
 	source "$BR2_EXTERNAL_MINIMAL_RPI_PATH/package/rtl-sdr/Config.in" 
 	source "$BR2_EXTERNAL_MINIMAL_RPI_PATH/package/qt-gstreamer/Config.in" 
 	source "$BR2_EXTERNAL_MINIMAL_RPI_PATH/package/telepi/Config.in" 
 	source "$BR2_EXTERNAL_MINIMAL_RPI_PATH/package/libtermkey/Config.in" 
 	source "$BR2_EXTERNAL_MINIMAL_RPI_PATH/package/termkeyboard/Config.in" 
 	source "$BR2_EXTERNAL_MINIMAL_RPI_PATH/package/dispmanx-vnc/Config.in" 
endmenu
```

## configs/raspberrypi3_minimal_defconfig
```kconfig
BR2_arm=y
BR2_cortex_a53=y
BR2_ARM_FPU_NEON_VFPV4=y
BR2_DL_DIR="$(TOPDIR)/../buildroot_dl"
BR2_CCACHE=y

#BR2_TOOLCHAIN_EXTERNAL=y
#BR2_TOOLCHAIN_EXTERNAL_CUSTOM=y
#BR2_TOOLCHAIN_EXTERNAL_DOWNLOAD=y
#BR2_TOOLCHAIN_EXTERNAL_URL="http://toolchains.free-electrons.com/downloads/releases/toolchains/armv7-eabihf/tarballs/armv7-eabihf--musl--stable-2018.11-1.tar.bz2"
#BR2_TOOLCHAIN_EXTERNAL_GCC_7=y
#BR2_TOOLCHAIN_EXTERNAL_HEADERS_4_9=y
## BR2_TOOLCHAIN_EXTERNAL_LOCALE is not set
#BR2_TOOLCHAIN_EXTERNAL_CXX=y
#BR2_TOOLCHAIN_EXTERNAL_HAS_SSP=y
#BR2_TOOLCHAIN_EXTERNAL_HAS_THREADS_DEBUG=y
#BR2_TOOLCHAIN_EXTERNAL_HAS_THREADS=y
#BR2_TOOLCHAIN_EXTERNAL_HAS_THREADS_NPTL=y
#BR2_TOOLCHAIN_EXTERNAL_CUSTOM_MUSL=y

BR2_ARCH_HAS_TOOLCHAIN_BUILDROOT=y
BR2_TOOLCHAIN=y
BR2_TOOLCHAIN_USES_MUSL=y
BR2_TOOLCHAIN_BUILDROOT=y
BR2_TOOLCHAIN_BUILDROOT_VENDOR="buildroot"
BR2_TOOLCHAIN_BUILDROOT_MUSL=y
BR2_TOOLCHAIN_BUILDROOT_LIBC="musl"
BR2_TOOLCHAIN_BUILDROOT_CXX=y
BR2_TOOLCHAIN_HAS_THREADS=y
BR2_TOOLCHAIN_HAS_THREADS_NPTL=y
BR2_TOOLCHAIN_HAS_THREADS_DEBUG=y
BR2_TOOLCHAIN_HAS_SSP=y
BR2_TOOLCHAIN_SUPPORTS_PIE=y
BR2_TOOLCHAIN_GCC_AT_LEAST="6"
BR2_TOOLCHAIN_HAS_MNAN_OPTION=y
BR2_TOOLCHAIN_HAS_SYNC_1=y
BR2_TOOLCHAIN_HAS_SYNC_2=y
BR2_TOOLCHAIN_HAS_SYNC_4=y
BR2_TOOLCHAIN_HAS_LIBATOMIC=y
BR2_TOOLCHAIN_HAS_ATOMIC=y

BR2_ROOTFS_DEVICE_CREATION_DYNAMIC_MDEV=y
BR2_SYSTEM_DHCP="eth0"
BR2_ROOTFS_OVERLAY="$(BR2_EXTERNAL_MINIMAL_RPI_PATH)/board/raspberrypi3/rootfs_overlay"
BR2_ROOTFS_POST_BUILD_SCRIPT="$(BR2_EXTERNAL_MINIMAL_RPI_PATH)/board/raspberrypi3/post-build.sh"
BR2_ROOTFS_POST_IMAGE_SCRIPT="board/raspberrypi3/post-image.sh"
BR2_ROOTFS_POST_SCRIPT_ARGS="--add-pi3-miniuart-bt-overlay"
BR2_LINUX_KERNEL=y
BR2_LINUX_KERNEL_CUSTOM_GIT=y
BR2_LINUX_KERNEL_CUSTOM_REPO_URL="https://github.com/raspberrypi/linux.git"
BR2_LINUX_KERNEL_CUSTOM_REPO_VERSION="rpi-4.9.y-stable"
BR2_KERNEL_HEADERS_4_9=y
BR2_LINUX_KERNEL_USE_CUSTOM_CONFIG=y
BR2_LINUX_KERNEL_CUSTOM_CONFIG_FILE="$(BR2_EXTERNAL_MINIMAL_RPI_PATH)/board/raspberrypi3/linux.config"
BR2_LINUX_KERNEL_LZO=y
BR2_LINUX_KERNEL_DTS_SUPPORT=y
BR2_LINUX_KERNEL_INTREE_DTS_NAME="bcm2710-rpi-3-b bcm2710-rpi-cm3"
BR2_PACKAGE_BUSYBOX_CONFIG="$(BR2_EXTERNAL_MINIMAL_RPI_PATH)/board/raspberrypi3/busybox.config"
BR2_PACKAGE_RPI_FIRMWARE=y
BR2_PACKAGE_RPI_WIFI_FIRMWARE=y
BR2_PACKAGE_RPI_BT_FIRMWARE=y
BR2_PACKAGE_WPA_SUPPLICANT=y
BR2_TARGET_ROOTFS_EXT2=y
BR2_TARGET_ROOTFS_EXT2_4=y
BR2_TARGET_ROOTFS_EXT2_SIZE="10M"
# BR2_TARGET_ROOTFS_TAR is not set
BR2_PACKAGE_HOST_DOSFSTOOLS=y
BR2_PACKAGE_HOST_GENIMAGE=y
BR2_PACKAGE_HOST_MTOOLS=y

BR2_PACKAGE_GSTREAMER1=y
BR2_PACKAGE_GSTREAMER1_PARSE=y
BR2_PACKAGE_GSTREAMER1_TRACE=y
BR2_PACKAGE_GSTREAMER1_GST_DEBUG=y
BR2_PACKAGE_GSTREAMER1_PLUGIN_REGISTRY=y
BR2_PACKAGE_GSTREAMER1_INSTALL_TOOLS=y
BR2_PACKAGE_QT5_JSCORE_AVAILABLE=y
BR2_PACKAGE_QT5_GL_AVAILABLE=y
BR2_PACKAGE_QT5=y
BR2_PACKAGE_QT5_VERSION_LATEST=y
BR2_PACKAGE_QT5BASE=y
BR2_PACKAGE_QT5BASE_CUSTOM_CONF_OPTS=""
BR2_PACKAGE_QT5BASE_CONFIG_FILE=""
BR2_PACKAGE_QT5BASE_NETWORK=y
BR2_PACKAGE_QT5BASE_SQL=y
BR2_PACKAGE_QT5BASE_SQLITE_NONE=y
BR2_PACKAGE_QT5BASE_TEST=y
BR2_PACKAGE_QT5BASE_XML=y
BR2_PACKAGE_QT5BASE_GUI=y
BR2_PACKAGE_QT5BASE_LINUXFB=y
BR2_PACKAGE_QT5BASE_DEFAULT_QPA=""
BR2_PACKAGE_QT5MULTIMEDIA=y

BR2_PACKAGE_RPI_USERLAND=y
BR2_PACKAGE_RPI_USERLAND_START_VCFILED=y
BR2_PACKAGE_RPI_USERLAND_HELLO=y

BR2_PACKAGE_BLUEZ_TOOLS=y
BR2_PACKAGE_BLUEZ5_UTILS=y
```

## configs/raspberrypi_defconfig
```kconfig
BR2_arm=y
#BR2_cortex_a53=y #RPi3
#BR2_ARM_FPU_NEON_VFPV4=y
#BR2_cortex_a7=y #RPi2
BR2_arm1176jzf_s=y
BR2_DL_DIR="$(TOPDIR)/../buildroot_dl"
BR2_CCACHE=y

#BR2_TOOLCHAIN_EXTERNAL=y
#BR2_TOOLCHAIN_EXTERNAL_CUSTOM=y
#BR2_TOOLCHAIN_EXTERNAL_DOWNLOAD=y
#BR2_TOOLCHAIN_EXTERNAL_URL="http://toolchains.free-electrons.com/downloads/releases/toolchains/armv7-eabihf/tarballs/armv7-eabihf--musl--stable-2018.11-1.tar.bz2"
#BR2_TOOLCHAIN_EXTERNAL_GCC_7=y
#BR2_TOOLCHAIN_EXTERNAL_HEADERS_4_9=y
## BR2_TOOLCHAIN_EXTERNAL_LOCALE is not set
#BR2_TOOLCHAIN_EXTERNAL_CXX=y
#BR2_TOOLCHAIN_EXTERNAL_HAS_SSP=y
#BR2_TOOLCHAIN_EXTERNAL_HAS_THREADS_DEBUG=y
#BR2_TOOLCHAIN_EXTERNAL_HAS_THREADS=y
#BR2_TOOLCHAIN_EXTERNAL_HAS_THREADS_NPTL=y
#BR2_TOOLCHAIN_EXTERNAL_CUSTOM_MUSL=y

BR2_ARCH_HAS_TOOLCHAIN_BUILDROOT=y
BR2_TOOLCHAIN=y
BR2_TOOLCHAIN_USES_MUSL=y
BR2_TOOLCHAIN_BUILDROOT=y
BR2_TOOLCHAIN_BUILDROOT_VENDOR="buildroot"
BR2_TOOLCHAIN_BUILDROOT_MUSL=y
BR2_TOOLCHAIN_BUILDROOT_LIBC="musl"
BR2_TOOLCHAIN_BUILDROOT_CXX=y
BR2_TOOLCHAIN_HAS_THREADS=y
BR2_TOOLCHAIN_HAS_THREADS_NPTL=y
BR2_TOOLCHAIN_HAS_THREADS_DEBUG=y
BR2_TOOLCHAIN_HAS_SSP=y
BR2_TOOLCHAIN_SUPPORTS_PIE=y
BR2_TOOLCHAIN_GCC_AT_LEAST="6"
BR2_TOOLCHAIN_HAS_MNAN_OPTION=y
BR2_TOOLCHAIN_HAS_SYNC_1=y
BR2_TOOLCHAIN_HAS_SYNC_2=y
BR2_TOOLCHAIN_HAS_SYNC_4=y
BR2_TOOLCHAIN_HAS_LIBATOMIC=y
BR2_TOOLCHAIN_HAS_ATOMIC=y

BR2_TARGET_GENERIC_ROOT_PASSWD="headunit"

BR2_ROOTFS_DEVICE_CREATION_DYNAMIC_EUDEV=y
BR2_SYSTEM_DHCP="eth0"
BR2_ROOTFS_OVERLAY="$(BR2_EXTERNAL_MINIMAL_RPI_PATH)/board/raspberrypi/rootfs_overlay"
BR2_ROOTFS_POST_BUILD_SCRIPT="$(BR2_EXTERNAL_MINIMAL_RPI_PATH)/board/raspberrypi/post-build.sh"
BR2_ROOTFS_POST_IMAGE_SCRIPT="$(BR2_EXTERNAL_MINIMAL_RPI_PATH)/board/raspberrypi/post-image.sh"
BR2_ROOTFS_POST_SCRIPT_ARGS="--add-pi3-miniuart-bt-overlay"
BR2_LINUX_KERNEL=y
BR2_LINUX_KERNEL_CUSTOM_GIT=y
BR2_LINUX_KERNEL_CUSTOM_REPO_URL="https://github.com/raspberrypi/linux.git"
BR2_LINUX_KERNEL_CUSTOM_REPO_VERSION="rpi-4.9.y-stable"
BR2_KERNEL_HEADERS_4_9=y
BR2_LINUX_KERNEL_USE_CUSTOM_CONFIG=y
BR2_LINUX_KERNEL_CUSTOM_CONFIG_FILE="$(BR2_EXTERNAL_MINIMAL_RPI_PATH)/board/raspberrypi/linux.config"
BR2_LINUX_KERNEL_LZO=y
BR2_LINUX_KERNEL_DTS_SUPPORT=y
BR2_LINUX_KERNEL_INTREE_DTS_NAME="bcm2708-rpi-b bcm2708-rpi-cm bcm2708-rpi-b-plus bcm2709-rpi-2-b bcm2710-rpi-3-b bcm2710-rpi-cm3 bcm2710-rpi-3-b-plus"
BR2_PACKAGE_BUSYBOX_CONFIG="$(BR2_EXTERNAL_MINIMAL_RPI_PATH)/board/raspberrypi/busybox.config"
BR2_PACKAGE_RPI_FIRMWARE=y
BR2_PACKAGE_RPI_WIFI_FIRMWARE=y
BR2_PACKAGE_RPI_BT_FIRMWARE=y
BR2_PACKAGE_WPA_SUPPLICANT=y
BR2_TARGET_ROOTFS_EXT2=y
BR2_TARGET_ROOTFS_EXT2_4=y
BR2_TARGET_ROOTFS_EXT2_SIZE="256M"
# BR2_TARGET_ROOTFS_TAR is not set
BR2_PACKAGE_HOST_DOSFSTOOLS=y
BR2_PACKAGE_HOST_GENIMAGE=y
BR2_PACKAGE_HOST_MTOOLS=y
BR2_PACKAGE_DTC=y
# BR2_PACKAGE_DTC_PROGRAMS is not set

BR2_PACKAGE_RPI_USERLAND=y
#BR2_PACKAGE_RPI_USERLAND_START_VCFILED is not defined
BR2_PACKAGE_RPI_USERLAND_HELLO=y
BR2_PACKAGE_OPENSSH=y

BR2_PACKAGE_BLUEZ_TOOLS=y
BR2_PACKAGE_BLUEZ5_UTILS=y

BR2_PACKAGE_GSTREAMER1=y
BR2_PACKAGE_GSTREAMER1_PARSE=y
BR2_PACKAGE_GSTREAMER1_TRACE=y
BR2_PACKAGE_GSTREAMER1_GST_DEBUG=y
BR2_PACKAGE_GSTREAMER1_PLUGIN_REGISTRY=y
BR2_PACKAGE_GSTREAMER1_INSTALL_TOOLS=y
BR2_PACKAGE_GST1_PLUGINS_BASE=y
BR2_PACKAGE_GST1_PLUGINS_BASE_PLUGIN_AUDIOCONVERT=y
BR2_PACKAGE_GST1_PLUGINS_BASE_PLUGIN_PLAYBACK=y
BR2_PACKAGE_GST1_PLUGINS_BASE_PLUGIN_AUDIORESAMPLE=y
BR2_PACKAGE_GST1_PLUGINS_BASE_PLUGIN_TYPEFIND=y
BR2_PACKAGE_GST1_PLUGINS_BASE_PLUGIN_VIDEOSCALE=y
BR2_PACKAGE_GST1_PLUGINS_BASE_PLUGIN_VOLUME=y
BR2_PACKAGE_GST1_PLUGINS_BASE_LIB_OPENGL=y
BR2_PACKAGE_GST1_PLUGINS_BASE_LIB_OPENGL_GLES2=y
BR2_PACKAGE_GST1_PLUGINS_BASE_LIB_OPENGL_EGL=y
BR2_PACKAGE_GST1_PLUGINS_BASE_LIB_OPENGL_DISPMANX=y

BR2_PACKAGE_QT5_JSCORE_AVAILABLE=y
BR2_PACKAGE_QT5_GL_AVAILABLE=y
BR2_PACKAGE_QT5=y
BR2_PACKAGE_QT5_VERSION_LATEST=y
BR2_PACKAGE_QT5BASE=y
BR2_PACKAGE_QT5BASE_CUSTOM_CONF_OPTS=""
BR2_PACKAGE_QT5BASE_CONFIG_FILE=""
BR2_PACKAGE_QT5BASE_NETWORK=y
BR2_PACKAGE_QT5BASE_SQL=y
BR2_PACKAGE_QT5BASE_SQLITE_NONE=y
BR2_PACKAGE_QT5BASE_TEST=y
BR2_PACKAGE_QT5BASE_XML=y
BR2_PACKAGE_QT5BASE_GUI=y
BR2_PACKAGE_QT5BASE_OPENGL=y
BR2_PACKAGE_QT5BASE_OPENGL_ES2=y
BR2_PACKAGE_QT5BASE_OPENGL_LIB=y
BR2_PACKAGE_QT5BASE_LINUXFB=y
BR2_PACKAGE_QT5BASE_EGLFS=y
BR2_PACKAGE_QT5BASE_DEFAULT_QPA="eglfs"
BR2_PACKAGE_QT5MULTIMEDIA=y
BR2_PACKAGE_QT5WEBENGINE_ARCH_SUPPORTS=y
BR2_GLOBAL_PATCH_DIR="$(BR2_EXTERNAL_MINIMAL_RPI_PATH)/patches"

BR2_PACKAGE_PROTOBUF=y
BR2_PACKAGE_LIBUSB=y
BR2_PACKAGE_LIBUSB_COMPAT=y
# BR2_PACKAGE_LIBUSB_EXAMPLES is not set
BR2_PACKAGE_QT5CONNECTIVITY=y
BR2_PACKAGE_QT5DECLARATIVE=y
BR2_PACKAGE_QT5DECLARATIVE_QUICK=y
BR2_PACKAGE_QT5CHARTS=y
BR2_PACKAGE_QT5GRAPHICALEFFECTS=y
BR2_PACKAGE_QT5QUICKCONTROLS=y
BR2_PACKAGE_QT5QUICKCONTROLS2=y
BR2_PACKAGE_OFONO=y
BR2_PACKAGE_GST1_PLUGINS_BASE_PLUGIN_APP=y
BR2_PACKAGE_OPENSSL=y
BR2_PACKAGE_TAGLIB=y
BR2_PACKAGE_TAGLIB_MP4=y
BR2_PACKAGE_TAGLIB_ASF=y
BR2_PACKAGE_HEADUNIT_DESKTOP=y
BR2_PACKAGE_LIBTOOL=y
BR2_PACKAGE_LIBVORBIS=y
BR2_PACKAGE_LIBCANBERRA=y
BR2_PACKAGE_LIBQOFONO=y
BR2_PACKAGE_EXTRA_CMAKE_MODULES=y
BR2_PACKAGE_BLUEZ_QT=y
BR2_PACKAGE_GCONF2=y
BR2_PACKAGE_LIBXML2=y
BR2_PACKAGE_PULSEAUDIO=y
BR2_PACKAGE_PULSEAUDIO_DAEMON=y
BR2_PACKAGE_QT_GSTREAMER=y
BR2_PACKAGE_FFTW=y
#BR2_PACKAGE_FFTW_USE_NEON=y    #only for rpi2 and above
BR2_PACKAGE_FFTW_PRECISION_SINGLE=y
BR2_PACKAGE_RTL_SDR=y
BR2_PACKAGE_FAAD2=y
BR2_PACKAGE_QT5SVG=y
BR2_PACKAGE_LIBPNG=y
BR2_PACKAGE_QT5BASE_FONTCONFIG=y
BR2_PACKAGE_FONTCONFIG=y
BR2_PACKAGE_QT5BASE_PNG=y
BR2_PACKAGE_I2C_TOOLS=y


# REMOTE DEVELOPMENT
BR2_PACKAGE_LIBEVDEV=y
BR2_PACKAGE_EVTEST=y
BR2_PACKAGE_LIBVNCSERVER=y
BR2_PACKAGE_LIBVNCSERVER_TIGHTPNG=y
BR2_PACKAGE_JPEG=y
BR2_PACKAGE_JPEG_SIMD_SUPPORT=y
BR2_PACKAGE_JPEG_TURBO=y
BR2_PACKAGE_PROVIDES_JPEG="jpeg-turbo"
BR2_PACKAGE_DISPMANX_VNC=y
```

## package/bluez-qt/Config.in
```kconfig
config BR2_PACKAGE_BLUEZ_QT
	bool "bluez-qt"
	depends on BR2_PACKAGE_EXTRA_CMAKE_MODULES
	depends on BR2_PACKAGE_QT5BASE
	help
        Adds bluez-qt package 
	https://github.com/KDE/bluez-qt
```

## package/dispmanx-vnc/Config.in
```kconfig
config BR2_PACKAGE_DISPMANX_VNC
	bool "dispmanx-vnc"
	help
	VNC Server for Raspberry PI using dispmanx
	https://github.com/hanzelpeter/dispmanx_vnc
```

## package/headunit-desktop/Config.in
```kconfig
config BR2_PACKAGE_HEADUNIT_DESKTOP
	bool "headunit-desktop"
	depends on BR2_PACKAGE_BLUEZ_QT
	depends on BR2_PACKAGE_LIBCANBERRA
	depends on BR2_PACKAGE_LIBQOFONO
	depends on BR2_PACKAGE_QT5BASE
	depends on BR2_PACKAGE_QT5QUICKCONTROLS2
	depends on BR2_PACKAGE_GCONF2
	depends on BR2_PACKAGE_QT_GSTREAMER
	depends on BR2_PACKAGE_PROTOBUF
	depends on BR2_PACKAGE_FFTW
	depends on BR2_PACKAGE_FFTW_USE_NEON
	depends on BR2_PACKAGE_FFTW_PRECISION_SINGLE
	depends on BR2_PACKAGE_RTL_SDR
	depends on BR2_PACKAGE_FAAD2
	help
        Adds headunit-desktop package 
        https://github.com/viktorgino/headunit-desktop
```

## package/libcanberra/Config.in
```kconfig
config BR2_PACKAGE_LIBCANBERRA
	bool "libcanberra"
	help
        Adds libcanberra package 
	http://0pointer.de/lennart/projects/libcanberra/#overview
```

## package/libqofono/Config.in
```kconfig
config BR2_PACKAGE_LIBQOFONO
	bool "libqofono"
	help
        Adds libqofono package 
	https://git.merproject.org/mer-core/libqofono
```

## package/libtermkey/Config.in
```kconfig
config BR2_PACKAGE_LIBTERMKEY
	bool "libtermkey"
	help
        Adds libtermkey package 
	https://github.com/neovim/libtermkey
```

## package/qt-gstreamer/Config.in
```kconfig
comment "qt-gstreamer need Qt (4 or 5) and gstreamer (0.10 or 1.0)"
	depends on !(BR2_PACKAGE_QT5 || BR2_PACKAGE_QT4)
	depends on !(BR2_PACKAGE_GSTREAMER || BR2_PACKAGE_GSTREAMER1)

config BR2_PACKAGE_QT_GSTREAMER
	bool "qt-gstreamer"
	select BR2_PACKAGE_BOOST
	depends on BR2_PACKAGE_QT5 || BR2_PACKAGE_QT4
	depends on BR2_PACKAGE_GSTREAMER || BR2_PACKAGE_GSTREAMER1
	help
	  QtGStreamer is a set of libraries providing C++ bindings for GStreamer
	  with a Qt-style API, plus some helper classes and elements for
	  integrating GStreamer better in Qt applications.

	  http://gstreamer.freedesktop.org/modules/qt-gstreamer.html

if BR2_PACKAGE_QT_GSTREAMER

config BR2_PACKAGE_QT_GSTREAMER_EXAMPLES
	bool "Install exemples"
	help
	  Compile and install exemples on target

endif
```

## package/rtl-sdr/Config.in
```kconfig
config BR2_PACKAGE_RTL_SDR
	bool "rtl-sdr"
	depends on BR2_PACKAGE_LIBUSB
	depends on BR2_PACKAGE_LIBUSB_COMPAT
	help
        Adds Software to turn the RTL2832U into a SDR receiver
	https://osmocom.org/projects/rtl-sdr/wiki
```

## package/telepi/Config.in
```kconfig
config BR2_PACKAGE_TELEPI
	bool "telepi"
	help
	Remote streaming for your Raspberry Pi
	https://github.com/DougGore/telepi
```

## package/termkeyboard/Config.in
```kconfig
config BR2_PACKAGE_TERMKEYBOARD
	bool "termkeyboard"
	help
        Adds termkeyboard package 
	https://github.com/chaitu236/TermKeyboard
```
